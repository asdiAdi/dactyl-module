## boards/shields/5x6_default/Kconfig.defconfig
```kconfig
if 5X6_DEFAULT_LEFT

# Name must be less than 16 characters long!
config ZMK_KEYBOARD_NAME
    default "Dactyl Manuform"

config ZMK_SPLIT_ROLE_CENTRAL
    default y

endif

if 5X6_DEFAULT_LEFT || 5X6_DEFAULT_RIGHT

config ZMK_SPLIT
    default y

endif
```

## boards/shields/5x6_default/Kconfig.shield
```kconfig
config 5X6_DEFAULT_LEFT
    def_bool $(shields_list_contains,5x6_default_left)

config 5X6_DEFAULT_RIGHT
    def_bool $(shields_list_contains,5x6_default_right)
```

## boards/shields/dactyl_manuform/Kconfig.defconfig
```kconfig
if DACTYL_MANUFORM_LEFT
# Name must be less than 16 characters long!
config ZMK_KEYBOARD_NAME
    default "Test A"
config ZMK_SPLIT_ROLE_CENTRAL
    default y
config ZMK_SPLIT
    default y
endif

if DACTYL_MANUFORM_RIGHT
config ZMK_SPLIT
    default y
endif
```
